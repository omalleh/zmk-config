/*
 * Copyright (c) 2020 The ZMK Contributors
 *
 * SPDX-License-Identifier: MIT
 */

#include <dt-bindings/zmk/matrix_transform.h>

/ {
	kscan0: kscan {
		compatible = "zmk,kscan-gpio-matrix";
		label = "KSCAN";
		
		diode-direction = "row2col";

		row-gpios
			= <&pro_micro B4 (GPIO_ACTIVE_HIGH | GPIO_PULL_DOWN)>
			, <&pro_micro B5 (GPIO_ACTIVE_HIGH | GPIO_PULL_DOWN)>
			, <&pro_micro D4 (GPIO_ACTIVE_HIGH | GPIO_PULL_DOWN)>
			, <&pro_micro C6 (GPIO_ACTIVE_HIGH | GPIO_PULL_DOWN)>
			, <&pro_micro D7 (GPIO_ACTIVE_HIGH | GPIO_PULL_DOWN)>
			, <&pro_micro E6 (GPIO_ACTIVE_HIGH | GPIO_PULL_DOWN)>
			, <&pro_micro F5 (GPIO_ACTIVE_HIGH | GPIO_PULL_DOWN)>
			, <&pro_micro F4 (GPIO_ACTIVE_HIGH | GPIO_PULL_DOWN)>
			;

		col-gpios
			= <&pro_micro F6 GPIO_ACTIVE_HIGH>
			, <&pro_micro F7 GPIO_ACTIVE_HIGH>
			, <&pro_micro B1 GPIO_ACTIVE_HIGH>
			, <&pro_micro B3 GPIO_ACTIVE_HIGH>
			, <&pro_micro B2 GPIO_ACTIVE_HIGH>
			, <&pro_micro B6 GPIO_ACTIVE_HIGH>
			;
	};
	
	left_encoder: encoder_left {
	    compatible = "alps,ec11";
	    label = "LEFT_ENCODER";
	    a-gpios = <PIN_A (GPIO_ACTIVE_HIGH | GPIO_PULL_UP)>;
	    b-gpios = <PIN_B (GPIO_ACTIVE_HIGH | GPIO_PULL_UP)>;
	    resolution = <4>;
	};

};
