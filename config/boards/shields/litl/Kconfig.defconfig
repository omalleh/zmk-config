## config/boards/shields/litl/Kconfig.defconfig
```kconfig
# Copyright (c) 2020 The ZMK Contributors
# SPDX-License-Identifier: MIT

if SHIELD_LITL

config ZMK_KEYBOARD_NAME
    default "Litl"

endif
```

## config/boards/shields/litl/Kconfig.shield
```kconfig
# Copyright (c) 2020 The ZMK Contributors
# SPDX-License-Identifier: MIT

config SHIELD_LITL
	def_bool $(shields_list_contains,litl)
```
